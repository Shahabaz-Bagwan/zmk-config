## boards/shields/corne/Kconfig.shield
```kconfig
# Copyright (c) 2020 Pete Johanson
# SPDX-License-Identifier: MIT

config SHIELD_CORNE_LEFT
    def_bool $(shields_list_contains,corne_left)

config SHIELD_CORNE_RIGHT
    def_bool $(shields_list_contains,corne_right)

# No whitespace after the comma or in the keyboard name!
config SHIELD_CORNE_DONGLE
    def_bool $(shields_list_contains,corne_dongle)
```

## config/boards/shields/chocofi/Kconfig.defconfig
```kconfig
# Copyright (c) 2020 The ZMK Contributors
# SPDX-License-Identifier: MIT

if SHIELD_CHOCOFI_DONGLE

config ZMK_KEYBOARD_NAME
	default "SBZ's Chocofi"
	
config ZMK_SPLIT_BLE_ROLE_CENTRAL
	default y
	
config ZMK_USB
	default y

endif #SHIELD_CHOCOFI_DONGLE

if ZMK_DISPLAY

config I2C
    default y

config SSD1306
    default y

endif # ZMK_DISPLAY

if LVGL

config LV_Z_VDB_SIZE
    default 64

config LV_DPI_DEF
    default 148

config LV_Z_BITS_PER_PIXEL
    default 1

choice LV_COLOR_DEPTH
    default LV_COLOR_DEPTH_1
endchoice

endif # LVGL

if SHIELD_CHOCOFI_LEFT || SHIELD_CHOCOFI_RIGHT || SHIELD_CHOCOFI_DONGLE 

config ZMK_SPLIT
	default y

config ZMK_BLE
	default y

endif
```

## config/boards/shields/chocofi/Kconfig.shield
```kconfig
# Copyright (c) 2020 Pete Johanson
# SPDX-License-Identifier: MIT

config SHIELD_CHOCOFI_LEFT
    def_bool $(shields_list_contains,chocofi_left)

config SHIELD_CHOCOFI_RIGHT
    def_bool $(shields_list_contains,chocofi_right)

# No whitespace after the comma or in the keyboard name!
config SHIELD_CHOCOFI_DONGLE
    def_bool $(shields_list_contains,chocofi_dongle)
```

## config/boards/shields/fifi/Kconfig.shield
```kconfig
config SHIELD_FIFI_LEFT
	def_bool $(shields_list_contains,fifi_left)

config SHIELD_FIFI_RIGHT
	def_bool $(shields_list_contains,fifi_right)
```

## config/west.yml
```yaml
manifest:
  remotes:
    - name: zmkfirmware
      url-base: https://github.com/zmkfirmware
    - name: englmaxi
      url-base: https://github.com/englmaxi
  projects:
    - name: zmk
      remote: zmkfirmware
      revision: v0.3
      import: app/west.yml
    - name: zmk-dongle-display
      remote: englmaxi
      revision: main
  self:
    path: config
```
